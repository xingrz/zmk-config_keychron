## config/boards/arm/keychron_k3_pro/Kconfig.board
```kconfig
# Copyright (c) 2023 XiNGRZ
# SPDX-License-Identifier: MIT

config BOARD_KEYCHRON_K3_PRO
	bool "Keychron K3 Pro"
	depends on SOC_STM32L432XX
```

## config/boards/arm/keychron_k3_pro/Kconfig.defconfig
```kconfig
# Copyright (c) 2023 XiNGRZ
# SPDX-License-Identifier: MIT

if BOARD_KEYCHRON_K3_PRO

config BOARD
	default "keychron_k3_pro"

config ZMK_KEYBOARD_NAME
	default "Keychron K3 Pro"

config ZMK_USB
	default y

choice ZMK_HID_REPORT_TYPE
	default ZMK_HID_REPORT_TYPE_NKRO
endchoice

endif # BOARD_KEYCHRON_K3_PRO
```

## config/boards/arm/keychron_k3_pro/keychron_k3_pro_defconfig
```kconfig
# Copyright (c) 2023 XiNGRZ
# SPDX-License-Identifier: MIT

# SoC
CONFIG_SOC_SERIES_STM32L4X=y
CONFIG_SOC_STM32L432XX=y
CONFIG_CLOCK_CONTROL=y
CONFIG_PINCTRL=y
CONFIG_ARM_MPU=y
CONFIG_HW_STACK_PROTECTION=y

# Key scanning
CONFIG_SPI=y
CONFIG_ZMK_KSCAN_MATRIX_POLLING=y
CONFIG_ZMK_KSCAN_DIRECT_POLLING=y

# RGB
CONFIG_ZMK_RGB_UNDERGLOW=y
CONFIG_ZMK_RGB_UNDERGLOW_EXT_POWER=n
CONFIG_ZMK_RGB_UNDERGLOW_AUTO_OFF_IDLE=y

# Storage
CONFIG_FLASH=y
CONFIG_FLASH_MAP=y
CONFIG_NVS=y
CONFIG_SETTINGS=y

# USB
CONFIG_USB_DEVICE_MANUFACTURER="Keychron"
CONFIG_USB_DEVICE_PRODUCT="K3 Pro"
```

## config/boards/arm/keychron_q1/Kconfig.board
```kconfig
# Copyright (c) 2022-2023 XiNGRZ
# SPDX-License-Identifier: MIT

config BOARD_KEYCHRON_Q1
	bool "Keychron Q1"
	depends on SOC_STM32L432XX
```

## config/boards/arm/keychron_q1/Kconfig.defconfig
```kconfig
# Copyright (c) 2022-2023 XiNGRZ
# SPDX-License-Identifier: MIT

if BOARD_KEYCHRON_Q1

config BOARD
	default "keychron_q1"

config ZMK_KEYBOARD_NAME
	default "Keychron Q1"

config ZMK_USB
	default y

choice ZMK_HID_REPORT_TYPE
	default ZMK_HID_REPORT_TYPE_NKRO
endchoice

endif # BOARD_KEYCHRON_Q1
```

## config/boards/arm/keychron_q1/drivers/gpio/Kconfig
```kconfig
# Copyright (c) 2022 The ZMK Contributors
# SPDX-License-Identifier: MIT

DT_COMPAT_TI_SNX4HC595 := ti,snx4hc595

menuconfig GPIO_SNX4HC595
	bool "TI SNx4HC595 8-bit Shift Register bit-bang driver"
	default $(dt_compat_enabled,$(DT_COMPAT_TI_SNX4HC595))
	depends on GPIO
	select HAS_DTS_GPIO
	help
	  Enable driver for TI SNx4HC595 shift register using GPIO bit-bang.

if GPIO_SNX4HC595

config GPIO_SNX4HC595_INIT_PRIORITY
	int "Init priority"
	default 45
	help
	  Device driver initialization priority.

endif #GPIO_SNX4HC595
```

## config/boards/arm/keychron_q1/drivers/led_strip/Kconfig
```kconfig
# Copyright (c) 2022 The ZMK Contributors
# SPDX-License-Identifier: MIT

rsource "Kconfig.composite"
rsource "Kconfig.ckled2001"
```

## config/boards/arm/keychron_q1/keychron_q1_defconfig
```kconfig
# Copyright (c) 2022-2023 XiNGRZ
# SPDX-License-Identifier: MIT

# SoC
CONFIG_SOC_SERIES_STM32L4X=y
CONFIG_SOC_STM32L432XX=y
CONFIG_CLOCK_CONTROL=y
CONFIG_PINCTRL=y
CONFIG_ARM_MPU=y
CONFIG_HW_STACK_PROTECTION=y

# Key scanning
CONFIG_ZMK_KSCAN_MATRIX_POLLING=y
CONFIG_ZMK_KSCAN_MATRIX_WAIT_BETWEEN_OUTPUTS=30

# Encoder
CONFIG_EC11_TRIGGER_GLOBAL_THREAD=y

# RGB
CONFIG_ZMK_RGB_UNDERGLOW=y
CONFIG_ZMK_RGB_UNDERGLOW_EXT_POWER=n

# Storage
CONFIG_FLASH=y
CONFIG_FLASH_MAP=y
CONFIG_NVS=y
CONFIG_SETTINGS=y

# USB
CONFIG_USB_DEVICE_MANUFACTURER="Keychron"
CONFIG_USB_DEVICE_PRODUCT="Q1"
```

## config/drivers/Kconfig
```kconfig
# Copyright (c) 2022-2023 XiNGRZ
# SPDX-License-Identifier: MIT

rsource "ble_ext/Kconfig"
rsource "gpio/Kconfig"
rsource "led_strip/Kconfig"
```

## config/drivers/ble_ext/Kconfig
```kconfig
# Copyright (c) 2022-2023 XiNGRZ
# SPDX-License-Identifier: MIT

config BLE_EXT_CKBT51
	bool "CKBT51 external BT controller"
	default y
	depends on DT_HAS_KEYCHRON_CKBT51_ENABLED
	select SERIAL
	select UART_INTERRUPT_DRIVEN

if BLE_EXT_CKBT51

config BLE_EXT_CKBT51_THREAD_PRIORITY
	int "Thread priority"
	default 10

config BLE_EXT_CKBT51_THREAD_STACK_SIZE
	int "Thread stack size"
	default 1024

endif # BLE_EXT_CKBT51
```

## config/drivers/gpio/Kconfig
```kconfig
# Copyright (c) 2022-2023 XiNGRZ
# SPDX-License-Identifier: MIT

rsource "Kconfig.sn74hc595_bitbang"
```

## config/drivers/gpio/Kconfig.sn74hc595_bitbang
```kconfig
# Copyright (c) 2022-2023 XiNGRZ
# SPDX-License-Identifier: MIT

menuconfig GPIO_SN74HC595_BITBANG
	bool "SN74HC595 shift register, using GPIO bit-bang"
	default y
	depends on DT_HAS_TI_SN74HC595_BITBANG_ENABLED
	select GPIO
	help
	  Enable driver for SN74HC595 shift register

if GPIO_SN74HC595_BITBANG

config GPIO_SN74HC595_BITBANG_INIT_PRIORITY
	int "Init priority"
	default 45
	help
	  Device driver initialization priority.

endif # GPIO_SN74HC595_BITBANG
```

## config/drivers/led_strip/Kconfig
```kconfig
# Copyright (c) 2022-2023 XiNGRZ
# SPDX-License-Identifier: MIT

rsource "Kconfig.composite"
rsource "Kconfig.ckled2001"
```

## config/drivers/led_strip/Kconfig.ckled2001
```kconfig
# Copyright (c) 2022-2023 XiNGRZ
# SPDX-License-Identifier: MIT

config CKLED2001
	bool "CKLED2001 LED strip controller"
	default y
	depends on DT_HAS_KEYCHRON_CKLED2001_ENABLED
	select I2C
	select LED_STRIP
	help
	  Enable driver for CKLED2001 LED strip controller.
```

## config/drivers/led_strip/Kconfig.composite
```kconfig
# Copyright (c) 2022-2023 XiNGRZ
# SPDX-License-Identifier: MIT

config LED_STRIP_COMPOSITE
	bool "Composing multiple LED strip devices into one virtual device"
	default y
	depends on DT_HAS_ZMK_LED_STRIP_COMPOSITE_ENABLED
	select LED_STRIP
```

## config/dts/bindings/behaviors/zmk,behavior-outputs-switch.yaml
```yaml
# Copyright (c) 2023 XiNGRZ
# SPDX-License-Identifier: MIT

description: Switch outputs on press/release behavior

compatible: "zmk,behavior-outputs-switch"

include: two_param.yaml
```

## config/dts/bindings/ble_ext/keychron,ckbt51.yaml
```yaml
# Copyright (c) 2023 XiNGRZ
# SPDX-License-Identifier: MIT

description: CKBT51 external BT controller

compatible: "keychron,ckbt51"

properties:
  profile-count:
    type: int
    const: 3

  uart:
    type: phandle
    required: true

  reset-gpios:
    type: phandle-array
    required: true

  wakeup-gpios:
    type: phandle-array
    required: true

  wakeup-delay-us:
    type: int
    default: 3000
```

## config/dts/bindings/gpio/ti,sn74hc595-bitbang.yaml
```yaml
# Copyright (c) 2022-2023 XiNGRZ
# SPDX-License-Identifier: MIT

description: SN74HC595 shift register, using GPIO bit-bang

compatible: "ti,sn74hc595-bitbang"

include: gpio-controller.yaml

properties:
  "#gpio-cells":
    const: 2

  ser-gpios:
    type: phandle-array
    required: true

  srclk-gpios:
    type: phandle-array
    required: true

  rclk-gpios:
    type: phandle-array
    required: true

gpio-cells:
  - pin
  - flags
```

## config/dts/bindings/gpio/ti,snx4hc595.yaml
```yaml
# Copyright (c) 2022 The ZMK Contributors
# SPDX-License-Identifier: MIT

description: TI SNx4HC595 8-bit Shift Register

compatible: "ti,snx4hc595"

include: gpio-controller.yaml

properties:
  label:
    type: string
    required: true

  "#gpio-cells":
    const: 2

  ser-gpios:
    type: phandle-array
    required: true

  srclk-gpios:
    type: phandle-array
    required: true

  rclk-gpios:
    type: phandle-array
    required: true

gpio-cells:
  - pin
  - flags
```

## config/dts/bindings/led_strip/keychron,ckled2001.yaml
```yaml
# Copyright (c) 2022-2023 XiNGRZ
# SPDX-License-Identifier: MIT

description: CKLED2001 LED strip controller

compatible: "keychron,ckled2001"

include: [i2c-device.yaml]

properties:
  chain-length:
    type: int
    required: true

  init-delay-us:
    type: int
    default: 300

  scan-phase-channels:
    type: int
    default: 12
    enum:
      - 1
      - 2
      - 3
      - 4
      - 5
      - 6
      - 7
      - 8
      - 9
      - 10
      - 11
      - 12

  map:
    type: array
    required: true
```

## config/dts/bindings/led_strip/zmk,led-strip-composite.yaml
```yaml
# Copyright (c) 2022-2023 XiNGRZ
# SPDX-License-Identifier: MIT

description: Composing multiple LED strip devices into one virtual device

compatible: "zmk,led-strip-composite"

properties:
  chain-length:
    type: int
    required: true

child-binding:
  description: "Details of an included led_strip devices"
  properties:
    led-strip:
      type: phandle
      required: true
```

## config/west.yml
```yaml
manifest:
  projects:
    - name: zmk
      url: https://github.com/xingrz/zmk.git
      revision: feature/ble-ext
      import: app/west.yml
  self:
    path: config
```
