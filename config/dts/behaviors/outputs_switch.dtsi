/*
 * Copyright (c) 2023 XiNGRZ
 * SPDX-License-Identifier: MIT
 */

/ {
	behaviors {
		/omit-if-no-ref/ osw: behavior_outputs_switch {
			compatible = "zmk,behavior-outputs-switch";
			label = "OSW";
			#binding-cells = <2>;
		};
	};
};
